#include <Arduino.h>
#include <Adafruit_GFX.h>
#include <Adafruit_SH1106.h>

#define OLED_RESET -1
Adafruit_SH1106 display(OLED_RESET);

// oil Pressure
const float pressureZero = 102.4; // raw value at 0 psi 0.5v
const float pressureMax = 921.6; // raw value at max psi 4.5v
const int pressureTransducermaxPSI = 150;

const unsigned int MAX_BUFFER_LENGTH = 10;
const long bootAnimation = 1000;

const unsigned char epd_bitmap_frame_0_delay_0 [] PROGMEM = {
	0x00, 0x00, 0x00, 0x00, 0x00, 0x00, 0x00, 0x00, 0x00, 0x00, 0x00, 0x00, 0x00, 0x00, 0x00, 0x00, 
	0x00, 0x00, 0x00, 0x00, 0x00, 0x00, 0x00, 0x00, 0x00, 0x00, 0x00, 0x00, 0x00, 0x00, 0x00, 0x00, 
	0x00, 0x00, 0x00, 0x00, 0x00, 0x00, 0x00, 0x00, 0x00, 0x00, 0x00, 0x00, 0x00, 0x00, 0x00, 0x00, 
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	0x00, 0x00, 0x00, 0x00, 0x00, 0x00, 0x00, 0x00, 0x00, 0x00, 0x00, 0x00, 0x00, 0x00, 0x00, 0x00
};

const int epd_bitmap_allArray_LEN = 1;
const unsigned char* epd_bitmap_allArray[epd_bitmap_allArray_LEN] = {
  epd_bitmap_frame_0_delay_0,
};
bool booted = false;

// Get an resistor that should be most accurate at the required temp
float getTemperatureByPinSteinhart(int pin, double knownTemperatureResistor, double c1, double c2, double c3) {
  double adc_raw = analogRead(pin);
  double voltage = adc_raw / 1024.0 * 5;

  //  GND - resistor - input pin - sensor - 5V
  double resistance = ((5.0 * knownTemperatureResistor / voltage) - knownTemperatureResistor);

  //  5V - resistor - input pin - sensor - GND
  // double resistance = knownTemperatureResistor * (1 / ((5.0 / voltage) - 1));

  double logR  = log(resistance);
  double logR3 = logR * logR * logR;

  // 9.5 is // Dissipation factor (mW/°C)
  double steinhart = 1.0 / (c1 + c2 * logR + c3 * logR3);
  return steinhart - voltage * voltage / (9.5 * knownTemperatureResistor) - 273.15;
}

float getPressureByPin(int pin) {
  float pressureRaw = analogRead(pin);
  float pressureValue = ((pressureRaw - pressureZero) * pressureTransducermaxPSI) / (pressureMax - pressureZero);

  // cool, now lets not get below 0, how do we handle vacuum anyway - vacuum can be in kpa
  if (pressureValue < 0) {
    pressureValue = 0;
  }

  if (pressureValue > pressureTransducermaxPSI) {
    pressureValue = pressureTransducermaxPSI;
  }

  // From PSI to BAR
  return pressureValue * 0.0689475729;
}

void setup() {
  Serial.begin(115200);

  display.begin(SH1106_SWITCHCAPVCC, 0x3C);
  display.setTextSize(3);
  display.setTextColor(WHITE);
}

void loop() {
  unsigned long currentMillis = millis();

  // Boot animation
  if (!booted) {
    unsigned long endTime = currentMillis + bootAnimation;
    while (currentMillis <= endTime) {
      currentMillis = millis();

      for (int i = 0; i < epd_bitmap_allArray_LEN; i++) {
        display.clearDisplay();
        display.drawBitmap(0, 0, epd_bitmap_allArray[i], 128, 64, WHITE);
        display.display();
        delay(50);
      }
    }
    booted = true;
  }

  float oilTemp = getTemperatureByPinSteinhart(A0, 4700, 0.0007256952119519713, 0.00023918385992649434, 3.338981222442535e-8); // Alie new
  float oilPressure = getPressureByPin(A1);

  display.clearDisplay();
  display.setCursor(5, 0);

  display.print(oilTemp, 1);
  display.setCursor(90, -14);
  display.print(".");
  display.setCursor(105, 0);
  display.print("C");

  display.setCursor(5, 30);
  display.print(oilPressure, 1);
  display.setCursor(97, 30);
  display.print("b");
  display.setCursor(110, 30);

  display.display();
}
